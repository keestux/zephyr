/*
 * Copyright (c) 2019, Christian Taedcke
 *
 * SPDX-License-Identifier: Apache-2.0
 */
&usart2 {
	status = "okay";

	mx25l32: mx25l3233f@0 {
		compatible = "jedec,spi-nor";
		label = "MX25L3233F";
		reg = <0>;
		spi-max-frequency = <80000000>;
		wp-gpios = <&gpioa 22 0>;
		hold-gpios = <&gpioa 23 0>;
		size = <0x2000000>;
		has-be32k;
		jedec-id = [c2 20 16];
	};
};
