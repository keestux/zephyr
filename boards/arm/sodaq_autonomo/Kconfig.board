## boards/arm/sodaq_autonomo/Kconfig.board
```kconfig
# Kconfig - Sodaq Autonomo Board configuration
#
# Copyright (c) 2019 Sodaq BV.
# SPDX-License-Identifier: Apache-2.0

config BOARD_SODAQ_AUTONOMO
	bool "Sodaq Autonomo"
	depends on SOC_PART_NUMBER_SAMD21J18A
```

## boards/arm/sodaq_autonomo/Kconfig.defconfig
```kconfig
# Kconfig - Sodaq Autonomo board configuration
#
# Copyright (c) 2019 Sodaq BV.
# SPDX-License-Identifier: Apache-2.0

if BOARD_SODAQ_AUTONOMO

config BOARD
	default "sodaq_autonomo"

endif # BOARD_SODAQ_AUTONOMO
```
